## clients/embedded/esp32/main/Kconfig.projbuild
```kconfig
menu "Agent Device Protocol"

    config ADP_WIFI_SSID
        string "Wi-Fi network name"
        default ""

    config ADP_WIFI_PASSWORD
        string "Wi-Fi password"
        default ""

    config ADP_CONTROLLER_URL
        string "Controller address"
        default ""
        help
            ws://IPV4:PORT of the controller's outbound listener, with no path,
            for example ws://100.64.0.10:23112. Loopback, Tailscale (100.64.0.0/10)
            and private LAN addresses only. No DNS names.

    config ADP_RELAY_URL
        string "Controller address through a relay (wss://NAME, S006)"
        default ""
        help
            For a board that travels: the controller's relay listener published at a public
            name, for example wss://devices.example.com (a Cloudflare tunnel). Tried after the
            controller address. TLS with public roots carries it; the encrypted connection
            (S003) with the pinned keys runs inside. Needs the encrypted connection.

    config ADP_NETWORKS
        bool "Let the controller add and remove Wi-Fi networks (network grant, S005)"
        default n
        help
            Turning it on is the owner's network grant: network.add, network.remove and
            network.list over the encrypted connection only. The board keeps up to 8
            networks and joins the strongest it knows; passwords are never sent back.
            The network above is always one of them.

    config ADP_CONTROLLER_KEY
        string "Controller public key"
        default ""
        help
            The owning agent's controller key: 43 characters of unpadded base64url.

    config ADP_ASSIGNED_AGENT
        string "Owning agent's full AMP address"
        default ""
        help
            For example assistant@acme.aimaestro.local.

    config ADP_SECURE
        bool "Encrypted connection (/v1/secure, S003)"
        default y
        help
            Connect through /v1/secure: a key exchange signed with the pinned keys,
            then every message encrypted. Never falls back to /v1/connect. Required
            for a camera, microphone or speaker at a home network address. Turn it
            off only for a controller that does not implement S003.

    config ADP_DISPLAY_TEXT
        bool "Offer display.text (needs adp_board_show_text from your board port)"
        default n
        help
            Turn on only when the board has a screen and you have written
            adp_board_show_text() for it. Turning it on is the owner's local
            grant for display.text.

    config ADP_CAMERA
        bool "Offer camera.snapshot (Seeed XIAO ESP32-S3 Sense)"
        default n
        depends on IDF_TARGET_ESP32S3 && SPIRAM
        help
            Turn on only for a XIAO ESP32-S3 Sense with its camera board attached.
            Turning it on is the owner's local grant for camera.snapshot. The user
            LED is the capture sign: the camera runs only while it is on.

    config ADP_MICROPHONE
        bool "Microphone and talk button (Seeed XIAO ESP32-S3 Sense)"
        default n
        depends on IDF_TARGET_ESP32S3 && SPIRAM
        help
            Turning it on is the owner's microphone grant. Press the talk button and speak:
            the recording ends after one second of quiet and goes to the controller as an
            audio event, over the encrypted connection only. The user LED is on while the
            microphone runs.

    config ADP_TALK_GPIO
        int "Talk button pin"
        default 0
        depends on ADP_MICROPHONE
        help
            A button to ground. GPIO0 is the BOOT button.

    config ADP_LISTEN
        bool "Listen for a wake phrase (no button needed)"
        default n
        depends on ADP_MICROPHONE
        help
            Turning it on is the owner's listen grant (docs/wiki/specs/S004). The microphone
            runs all the time through a local detector; the LED is dim while it listens and
            bright while it records. Nothing is kept or sent until the detector hears the
            phrase; then the board records what the person says next, as the talk button does.
            After the agent's speech ends, the board records up to 8 seconds more for an answer.

    config ADP_WAKE_MODEL
        string "Wake phrase model (absolute path to a microWakeWord .tflite)"
        default ""
        depends on ADP_LISTEN
        help
            Built into the firmware. Models are the owner's files and are not in this
            repository: tools/wakeword trains one.

    config ADP_WAKE_PHRASE
        string "Wake phrase the model detects"
        default "hey bruce"
        depends on ADP_LISTEN
        help
            Lowercase letters, spaces and apostrophes. Sent to the controller as wakePhrase so
            the agent can tell people what to say.

    config ADP_WAKE_CUTOFF
        int "Detection cutoff, percent"
        range 1 99
        default 59
        depends on ADP_LISTEN
        help
            The mean probability of the last five 30 ms steps must be above this. The
            training script prints the cutoff for its measured false wakes per hour.

    config ADP_SPEAKER
        bool "Offer speaker.play through a MAX98357A amplifier"
        default n
        depends on IDF_TARGET_ESP32S3 && SPIRAM
        help
            Turning it on is the owner's grant for speaker.play: 16-bit PCM WAV, up to 384 KiB.

    config ADP_SPEAKER_VOLUME
        int "Speaker volume, percent of full scale"
        range 1 100
        default 12
        depends on ADP_SPEAKER
        help
            12 was the loudest clean level on a USB-powered XIAO with a MAX98357A on jumper
            wires. With a 100-470 uF capacitor across the amplifier's VIN and GND, or its
            own supply, it can go higher.

    config ADP_SPEAKER_BCLK
        int "Speaker amplifier BCLK pin"
        default 2
        depends on IDF_TARGET_ESP32S3
        help
            I2S bit clock to a MAX98357A. On the XIAO ESP32-S3: D1 is GPIO2.

    config ADP_SPEAKER_WS
        int "Speaker amplifier LRC (word select) pin"
        default 5
        depends on IDF_TARGET_ESP32S3
        help
            On the XIAO ESP32-S3: D4 is GPIO5.

    config ADP_SPEAKER_DOUT
        int "Speaker amplifier DIN pin"
        default 6
        depends on IDF_TARGET_ESP32S3
        help
            On the XIAO ESP32-S3: D5 is GPIO6.

    config ADP_DOCTOR
        bool "Check the hardware at boot (XIAO ESP32-S3 Sense)"
        default n
        depends on IDF_TARGET_ESP32S3 && SPIRAM
        help
            Before connecting, print one line per part to the USB console: chip, PSRAM, LED,
            Wi-Fi, controller address, microphone, speaker (a 1 kHz tone the microphone must
            hear) and camera. The LED is on whenever the microphone or camera runs.
            A debug build: the USB console also takes the test command "talk".

    config ADP_LOG_HOST
        string "Also send logs over Wi-Fi to (IPV4:PORT, UDP)"
        default ""
        depends on ADP_DOCTOR
        help
            For example 10.0.0.79:5514. Empty: logs stay on the USB console.

endmenu
```
